## 01-intro/hello_world/sdkconfig.defaults.esp32p4
```kconfig
# ESP32-P4X-Function-EV-Board: Flash 16MB、PSRAM 32MB
CONFIG_ESPTOOLPY_FLASHSIZE_16MB=y
CONFIG_SPIRAM=y
```

## 03-architecture/coremark/sdkconfig.defaults
```kconfig
# ESP32-P4X-Function-EV-Board（ESP-IDF v6.0.3）
CONFIG_IDF_TARGET="esp32p4"
CONFIG_ESPTOOLPY_FLASHSIZE_16MB=y
# CoreMark は 10 秒以上回るので、タスクのウォッチドッグを切る（元の例と同じ）
CONFIG_ESP_TASK_WDT_INIT=n
```

## 03-architecture/cpu_cache/sdkconfig.defaults
```kconfig
# ESP32-P4X-Function-EV-Board（ESP-IDF v6.0.3）
CONFIG_IDF_TARGET="esp32p4"
CONFIG_ESPTOOLPY_FLASHSIZE_16MB=y
# 速さを測るので -O2
CONFIG_COMPILER_OPTIMIZATION_PERF=y
```

## 04-psram/psram_bench/sdkconfig.defaults
```kconfig
# ESP32-P4X-Function-EV-Board（ESP-IDF v6.0.3）: PSRAM 200MHz（既定の速さ）
CONFIG_IDF_TARGET="esp32p4"
CONFIG_ESPTOOLPY_FLASHSIZE_16MB=y
CONFIG_SPIRAM=y
# 速さを測るので -O2
CONFIG_COMPILER_OPTIMIZATION_PERF=y
```

## 05-lp-core/lp_i2c_lis3dh/sdkconfig.defaults
```kconfig
# ESP32-P4X-Function-EV-Board（ESP-IDF v6.0.3）
CONFIG_IDF_TARGET="esp32p4"
CONFIG_ESPTOOLPY_FLASHSIZE_16MB=y
# LP コアを使う
CONFIG_ULP_COPROC_ENABLED=y
CONFIG_ULP_COPROC_TYPE_LP_CORE=y
CONFIG_ULP_COPROC_RESERVE_MEM=4096
```

## 06-ethernet-usb/eth_link/main/Kconfig.projbuild
```kconfig
menu "eth_link"

    config ETH_LINK_WATCH
        bool "Keep running and log every link change (cable plug/unplug test)"
        default n
        help
            n: read BMSR 4 times every 5 s, then print "done" (about 25 s).
            y: never stop. Poll BMSR every ETH_LINK_POLL_MS and print it only when
               it changes, and log ETHERNET_EVENT_CONNECTED/DISCONNECTED and
               IP_EVENT_ETH_GOT_IP/LOST_IP with the BMSR at that moment.

    config ETH_LINK_POLL_MS
        int "BMSR poll interval in watch mode (ms)"
        depends on ETH_LINK_WATCH
        range 10 5000
        default 100

endmenu
```

## 06-ethernet-usb/eth_link/sdkconfig.defaults
```kconfig
# ESP32-P4X-Function-EV-Board（ESP-IDF v6.0.3）
CONFIG_IDF_TARGET="esp32p4"
CONFIG_ESPTOOLPY_FLASHSIZE_16MB=y
CONFIG_ETH_ENABLED=y
CONFIG_ETH_USE_ESP32_EMAC=y
```

## 06-ethernet-usb/usb_cdc_speed/main/Kconfig.projbuild
```kconfig
menu "usb_cdc_speed"

    config USB_SPEED_USE_FS
        bool "Use the Full-Speed USB OTG (J20) instead of the High-Speed one"
        default n

endmenu
```

## 07-wifi6-hosted/wifi_sta/main/Kconfig.projbuild
```kconfig
menu "wifi_sta (P4X + C6)"

    choice WIFI_STA_SAE_PWE
        prompt "SAE (WPA3) の PWE の求め方（wifi_sta_config_t.sae_pwe_h2e）"
        default WIFI_STA_SAE_PWE_HNP
        help
            WPA3-Personal（SAE）のパスワード要素の求め方。wifi_config_t を {0} で初期化すると 0（Hunt-and-Peck）になる。
            ESP-IDF のヘッダの説明の既定は 2（BOTH）。
        config WIFI_STA_SAE_PWE_HNP
            bool "0: Hunt-and-Peck（{0} で初期化したときの値）"
        config WIFI_STA_SAE_PWE_H2E
            bool "1: Hash-to-Element"
        config WIFI_STA_SAE_PWE_BOTH
            bool "2: BOTH"
    endchoice

    config WIFI_STA_SAE_PWE
        int
        default 0 if WIFI_STA_SAE_PWE_HNP
        default 1 if WIFI_STA_SAE_PWE_H2E
        default 2 if WIFI_STA_SAE_PWE_BOTH

    choice WIFI_STA_AUTH_THRESHOLD
        prompt "つなぐ相手の最低の認証方式（wifi_sta_config_t.threshold.authmode）"
        default WIFI_STA_AUTH_THRESHOLD_OPEN
        config WIFI_STA_AUTH_THRESHOLD_OPEN
            bool "OPEN（{0} のまま。パスワードが 8 文字以上なら WPA2 以上として扱われる）"
        config WIFI_STA_AUTH_THRESHOLD_WPA2
            bool "WPA2_PSK"
        config WIFI_STA_AUTH_THRESHOLD_WPA3
            bool "WPA3_PSK（SAE だけ）"
    endchoice

    config WIFI_STA_CONNECT_AFTER_SETUP
        bool "esp_wifi_connect() を、送信出力の設定が終わってから呼ぶ（STA_START のイベントでは呼ばない）"
        default n
        help
            n: WIFI_EVENT_STA_START で esp_wifi_connect() を呼ぶ（ESP-IDF の例と同じ）。
            このとき P4 のメインのタスクは esp_wifi_set_max_tx_power() などの RPC を C6 に送っている途中で、接続と重なる。
            y: 送信出力の上限の設定と読み返しが終わってから、メインのタスクで esp_wifi_connect() を呼ぶ。

    config WIFI_STA_DIAG_LOG
        bool "接続の調査用に ESP-Hosted（P4 側）のログを DEBUG にする"
        default n
        help
            CONFIG_LOG_MAXIMUM_LEVEL_DEBUG も必要。Wi-Fi のドライバ自体は C6 の中で動くので、その詳しいログは C6 の UART に出る（P4 からは見えない）。

endmenu
```

## fft-s3-vs-p4/mic_fft/sdkconfig.defaults.esp32s3
```kconfig
# ESPr Developer S3 Type-C（ESP32-S3-WROOM-1-N16R8）: 240MHz
CONFIG_ESP_DEFAULT_CPU_FREQ_MHZ_240=y
```

## fft-s3-vs-p4/spectrum_demo/sdkconfig.defaults
```kconfig
# 全ターゲット共通
CONFIG_ESPTOOLPY_FLASHSIZE_16MB=y
# 速さを測るので -O2
CONFIG_COMPILER_OPTIMIZATION_PERF=y
CONFIG_ESP_TASK_WDT_INIT=n
```

## twai-can/can_node/main/Kconfig.projbuild
```kconfig
menu "CAN node"

    choice CAN_NODE_ROLE
        prompt "Role of this node"
        default CAN_NODE_ROLE_SELFTEST
        config CAN_NODE_ROLE_MASTER
            bool "Master (sends poll 0x100, receives 0x200-0x20F)"
        config CAN_NODE_ROLE_SLAVE
            bool "Slave (receives poll 0x100, replies 0x200 + node id)"
        config CAN_NODE_ROLE_SELFTEST
            bool "Self test on one board (TX = RX pin, no transceiver)"
    endchoice

    config CAN_NODE_ID
        int "Slave node id (1-15)"
        range 1 15
        default 1
        depends on CAN_NODE_ROLE_SLAVE

    config CAN_TX_GPIO
        int "TX GPIO (to transceiver TXD)"
        default 4

    config CAN_RX_GPIO
        int "RX GPIO (from transceiver RXD)"
        default 5

    config CAN_BITRATE
        int "Bitrate (bit/s)"
        default 500000

endmenu
```

## ulp-deep-sleep/sleep_wakeup/sdkconfig.defaults
```kconfig
# ESPr Developer S3 Type-C（ESP32-S3-WROOM-1-N16R8）
CONFIG_IDF_TARGET="esp32s3"
CONFIG_ESPTOOLPY_FLASHSIZE_16MB=y
# ブートローダの表示を減らし、起きるたびのログを読みやすくする
CONFIG_BOOTLOADER_LOG_LEVEL_WARN=y
```
